// Generated by scripts/generate-translations.py; edit translations/de.json.
static const Message messages[] = {
 {"   open", "   offen"},
 {"   secured", "   gesichert"},
 {"  /  Tap to save", "  /  Zum Speichern antippen"},
 {"  Display", "  Anzeige"},
 {"  Planes", "  Flugzeuge"},
 {"  Scan networks", "  Netzwerke suchen"},
 {"  Software Update", "  Software-Update"},
 {"  System", "  System"},
 {"  Time", "  Uhrzeit"},
 {"  Weather", "  Wetter"},
 {" - quotes may be delayed", " – Kurse ggf. verzögert"},
 {" / Platform ", " / Gleis "},
 {" / daily closes", " / Tagesschlusskurse"},
 {" Add stop", " Haltestelle hinzufügen"},
 {" High", " Hoch"},
 {" min", " Min."},
 {" min delayed", " Min. verzögert"},
 {"%.0f%% humidity", "%.0f%% Luftfeuchte"},
 {"%.1f %s away%s%s", "%.1f %s entfernt%s%s"},
 {"%d airborne nearby", "%d Flugzeuge in der Nähe"},
 {"%d player%s", "%d Spieler%s"},
 {"%lu seconds", "%lu Sekunden"},
 {"%s\n%.0f%% lit", "%s\n%.0f%% beleuchtet"},
 {"%s\nForecast", "%s\nVorhersage"},
 {"%s firmware / %s flash", "%s Firmware / %s Flash"},
 {"%s free / %s total", "%s frei / %s gesamt"},
 {"%s free / %s total, %u%% used", "%s frei / %s gesamt, %u%% belegt"},
 {"%s largest / %s minimum free", "%s größter Block / %s min. frei"},
 {"%s rev %u, %u cores @ %u MHz", "%s Rev. %u, %u Kerne @ %u MHz"},
 {"%s | %.0f %s alt.", "%s | %.0f %s Höhe"},
 {"%s | Altitude unknown", "%s | Höhe unbekannt"},
 {"%s: %d points\nRelease to confirm", "%s: %d Punkte\nZum Bestätigen loslassen"},
 {"-- min", "-- Min."},
 {"0° (Portrait)\n90° (Landscape)\n180° (Portrait Inverted)\n270° (Landscape Inverted)", "0° (Hochformat)\n90° (Querformat)\n180° (Hochformat gedreht)\n270° (Querformat gedreht)"},
 {"1Y", "1J"},
 {"24-hour format", "24-Stunden-Format"},
 {"3 kind", "3er-Pasch"},
 {"4 kind", "4er-Pasch"},
 {"5D", "5T"},
 {"A new version is ready to install.", "Eine neue Version ist verfügbar."},
 {"About Transitous", "Über Transitous"},
 {"Accept", "Übernehmen"},
 {"Add a favourite stop to get started", "Zuerst eine Haltestelle hinzufügen"},
 {"Add a location", "Ort hinzufügen"},
 {"Add stop", "Haltestelle hinzufügen"},
 {"Add symbols to start your watchlist", "Symbole zur Merkliste hinzufügen"},
 {"Africa", "Afrika"},
 {"Airborne aircraft appear here", "Flugzeuge werden hier angezeigt"},
 {"Aircraft", "Flugzeug"},
 {"All aircraft providers failed", "Alle Flugzeuganbieter nicht erreichbar"},
 {"Altitude", "Höhe"},
 {"America", "Amerika"},
 {"Apply language", "Sprache übernehmen"},
 {"Approaching", "Im Anflug"},
 {"Asia", "Asien"},
 {"Australia", "Australien"},
 {"Back to departures", "Zurück zu Abfahrten"},
 {"Bad JSON response", "Ungültige JSON-Antwort"},
 {"Brightness", "Helligkeit"},
 {"Build", "Build"},
 {"Cached", "Gespeichert"},
 {"Cached - refresh pending", "Gespeichert – Aktualisierung folgt"},
 {"Cached: ", "Gespeichert: "},
 {"Calculator", "Rechner"},
 {"Cancel", "Abbrechen"},
 {"Cancelled", "Fällt aus"},
 {"Cancelling update...", "Update wird abgebrochen ..."},
 {"Cannot open settings", "Einstellungen nicht verfügbar"},
 {"Cannot run curl", "curl konnte nicht gestartet werden"},
 {"Cannot save favourites", "Favoriten nicht gespeichert"},
 {"Cannot start request", "Anfrage konnte nicht gestartet werden"},
 {"Center Latitude", "Breitengrad"},
 {"Center Longitude", "Längengrad"},
 {"Change unavailable", "Änderung nicht verfügbar"},
 {"Changes are saved automatically", "Änderungen werden automatisch gespeichert"},
 {"Check for updates", "Nach Updates suchen"},
 {"Checking for updates...", "Updates werden gesucht ..."},
 {"Choose score", "Wertung wählen"},
 {"City or postal code", "Ort oder Postleitzahl"},
 {"Classic weather view", "Klassische Wetteransicht"},
 {"Clear", "Klar"},
 {"Clear sky", "Klarer Himmel"},
 {"Close", "Schließen"},
 {"Cloudy", "Bewölkt"},
 {"Config store unavailable", "Konfigurationsspeicher nicht verfügbar"},
 {"Configure center and range", "Mittelpunkt und Umkreis festlegen"},
 {"Connection failed", "Verbindung fehlgeschlagen"},
 {"Could not activate firmware", "Firmware nicht aktiviert"},
 {"Could not check for updates", "Update-Suche fehlgeschlagen"},
 {"Could not open OTA partition", "OTA-Partition nicht verfügbar"},
 {"Could not save language", "Sprache konnte nicht gespeichert werden"},
 {"Could not save update confirmation", "Update-Bestätigung nicht gespeichert"},
 {"Could not save watchlist", "Merkliste nicht gespeichert"},
 {"Could not start Plane request", "Flugzeugabfrage nicht gestartet"},
 {"Could not start installation", "Installation nicht gestartet"},
 {"Could not start lookup", "Suche konnte nicht gestartet werden"},
 {"Could not start network scan. Tap Scan to retry.", "Suche nicht gestartet. Erneut versuchen."},
 {"Could not start update check", "Update-Suche nicht gestartet"},
 {"Demo quotes", "Demo-Kurse"},
 {"Departed", "Abgefahren"},
 {"Departure", "Abfahrt"},
 {"Detailed\nClassic", "Detailliert\nKlassisch"},
 {"Dice Score", "Würfelspiel"},
 {"Direction", "Richtung"},
 {"Display", "Anzeige"},
 {"Distance", "Entfernung"},
 {"Due", "Jetzt"},
 {"Duplicate symbol: ", "Doppeltes Symbol: "},
 {"Edit watchlist", "Merkliste bearbeiten"},
 {"Enter SSID", "SSID eingeben"},
 {"Enter at least 2 characters", "Mindestens zwei Zeichen eingeben"},
 {"Enter at least two characters", "Mindestens zwei Zeichen eingeben"},
 {"Enter password", "Passwort eingeben"},
 {"Error", "Fehler"},
 {"Europe", "Europa"},
 {"Examples: AAPL  NESN.SW  7203.T", "Beispiele: AAPL  NESN.SW  7203.T"},
 {"Favourite stops", "Favoriten"},
 {"Find a stop", "Haltestelle suchen"},
 {"Firmware does not fit OTA partition", "Firmware zu groß für OTA-Partition"},
 {"Firmware download failed", "Firmware-Download fehlgeschlagen"},
 {"Firmware verification failed", "Firmware-Prüfung fehlgeschlagen"},
 {"First quarter", "Erstes Viertel"},
 {"Five", "5er-Pasch"},
 {"Five-location limit reached", "Höchstens fünf Orte möglich"},
 {"Fives", "Fünfer"},
 {"Fog", "Nebel"},
 {"Fours", "Vierer"},
 {"Framework", "Framework"},
 {"Fri", "Fr"},
 {"Friday", "Freitag"},
 {"Full", "Full House"},
 {"Full moon", "Vollmond"},
 {"Gadget OS %s is installed.", "Gadget OS %s ist installiert."},
 {"Gadget OS %s is now installed.", "Gadget OS %s ist jetzt installiert."},
 {"Gadget OS by", "Gadget OS von"},
 {"Gadget OS update", "Gadget-OS-Update"},
 {"Gadget OS version", "Gadget-OS-Version"},
 {"Game finished", "Spiel beendet"},
 {"Got it", "Verstanden"},
 {"Guess from IP", "Über IP ermitteln"},
 {"Guessed: ", "Ermittelt: "},
 {"Guessing location...", "Ort wird ermittelt ..."},
 {"HTTP begin failed", "HTTP-Anfrage nicht gestartet"},
 {"HTTP error", "HTTP-Fehler"},
 {"HTTPS client unavailable", "HTTPS nicht verfügbar"},
 {"Hardware", "Hardware"},
 {"Hide planes on ground", "Flugzeuge am Boden ausblenden"},
 {"History unavailable", "Kursverlauf nicht verfügbar"},
 {"Host build", "Host-Build"},
 {"Hourly ", "Stunden "},
 {"Hourly forecast", "Stündliche Vorhersage"},
 {"Hourly forecast unavailable", "Keine stündliche Vorhersage"},
 {"How many players?", "Wie viele Spieler?"},
 {"Ignore", "Ignorieren"},
 {"Ignored update available", "Ignoriertes Update verfügbar"},
 {"Include prereleases", "Vorabversionen zulassen"},
 {"Incomplete quote", "Unvollständiger Kurs"},
 {"Incomplete update manifest", "Unvollständige Update-Beschreibung"},
 {"Inconsistent chart", "Inkonsistenter Kursverlauf"},
 {"Install", "Installieren"},
 {"Installation is available on the device build", "Installation nur auf dem Gerät verfügbar"},
 {"Installed version\n%s", "Installierte Version\n%s"},
 {"Installed: %s\nAvailable: %s", "Installiert: %s\nVerfügbar: %s"},
 {"Installing... %d%%", "Installation ... %d%%"},
 {"Internal heap", "Interner Speicher"},
 {"Internal heap health", "Interner Speicherzustand"},
 {"Invalid center or range", "Ungültiger Mittelpunkt oder Umkreis"},
 {"Invalid chart time", "Ungültige Kurszeit"},
 {"Invalid currency", "Ungültige Währung"},
 {"Invalid departures", "Ungültige Abfahrtsdaten"},
 {"Invalid lookup response", "Ungültige Suchantwort"},
 {"Invalid provider response", "Ungültige Anbieterantwort"},
 {"Invalid request", "Ungültige Anfrage"},
 {"Invalid stop", "Ungültige Haltestelle"},
 {"Invalid stop search", "Ungültige Haltestellensuche"},
 {"Invalid symbol", "Ungültiges Symbol"},
 {"Invalid transit response", "Ungültige ÖPNV-Antwort"},
 {"Invalid update manifest", "Ungültige Update-Beschreibung"},
 {"Keep ignoring", "Weiter ignorieren"},
 {"LVGL heap", "LVGL-Speicher"},
 {"Labs  -  swipe right to return", "Labor – nach rechts zurückwischen"},
 {"Language", "Sprache"},
 {"Language saved. Returning home.", "Sprache gespeichert. Zur Startseite."},
 {"Last quarter", "Letztes Viertel"},
 {"Last trade - may be delayed", "Kurs ggf. verzögert"},
 {"Live", "Echtzeit"},
 {"Live  ", "Echtzeit "},
 {"Live  +", "Echtzeit +"},
 {"Live prediction", "Echtzeitprognose"},
 {"Loading", "Lädt"},
 {"Loading daily history...", "Kursverlauf wird geladen ..."},
 {"Loading departures...", "Abfahrten werden geladen ..."},
 {"Loading route...", "Route wird geladen ..."},
 {"Location already saved", "Ort bereits gespeichert"},
 {"Location guess failed", "Ort konnte nicht ermittelt werden"},
 {"Location lookup failed", "Ortssuche fehlgeschlagen"},
 {"Location saved and selected", "Ort gespeichert und ausgewählt"},
 {"Look %s", "Blick nach %s"},
 {"Looking for aircraft", "Suche nach Flugzeugen"},
 {"Looking for aircraft...", "Suche nach Flugzeugen ..."},
 {"Lookup HTTP error", "HTTP-Fehler bei Suche"},
 {"Lookup failed", "Suche fehlgeschlagen"},
 {"Lookup request failed", "Suchanfrage fehlgeschlagen"},
 {"Low ", "Tief "},
 {"Maximum 10 symbols", "Höchstens 10 Symbole"},
 {"Maximum 8 favourite stops", "Höchstens 8 Favoriten"},
 {"Metric (C)", "Metrisch (°C)"},
 {"Metric units", "Metrische Einheiten"},
 {"Mon", "Mo"},
 {"Monday", "Montag"},
 {"Moon", "Mond"},
 {"Moon data\nunavailable", "Keine\nMonddaten"},
 {"Moving away", "Entfernt sich"},
 {"Native simulator", "Nativer Simulator"},
 {"Nearby aircraft", "Flugzeuge in der Nähe"},
 {"Network request failed", "Netzwerkanfrage fehlgeschlagen"},
 {"Network scan failed. Tap Scan to retry.", "Suche fehlgeschlagen. Erneut suchen."},
 {"New moon", "Neumond"},
 {"New search", "Neue Suche"},
 {"No Wi-Fi networks found", "Keine WLAN-Netzwerke gefunden"},
 {"No aircraft nearby", "Keine Flugzeuge in der Nähe"},
 {"No history available", "Kein Kursverlauf verfügbar"},
 {"No matching locations", "Keine passenden Orte gefunden"},
 {"No matching stops", "Keine passenden Haltestellen"},
 {"No prerelease update feed found", "Keine Vorabversion gefunden"},
 {"No route details available", "Keine Routendetails verfügbar"},
 {"No route stops available", "Keine Haltestellen verfügbar"},
 {"No saved location", "Kein Ort gespeichert"},
 {"No upcoming departures", "Keine nächsten Abfahrten"},
 {"No weather data", "Keine Wetterdaten"},
 {"North up", "Norden oben"},
 {"Not available", "Nicht verfügbar"},
 {"Not enough memory for request", "Zu wenig Speicher für die Anfrage"},
 {"OTA is not enabled for this build", "OTA ist in diesem Build nicht aktiviert"},
 {"Offline / waiting for clock", "Offline / warte auf Uhrzeit"},
 {"One symbol per line (maximum 10)", "Ein Symbol pro Zeile (max. 10)"},
 {"Ones", "Einser"},
 {"Pacific", "Pazifik"},
 {"Pass the device after each turn", "Gerät nach jedem Zug weitergeben"},
 {"Passing by", "Fliegt vorbei"},
 {"Password", "Passwort"},
 {"Planes", "Flugzeuge"},
 {"Platform ", "Gleis "},
 {"Player %d  -  roll %d of 3", "Spieler %d – Wurf %d von 3"},
 {"Player %d  -  rolling...", "Spieler %d – würfelt ..."},
 {"Player %d wins with %d points!", "Spieler %d gewinnt mit %d Punkten!"},
 {"Prev close: ", "Vortag: "},
 {"Previous close unavailable", "Vortagesschluss nicht verfügbar"},
 {"Provider returned no aircraft list", "Anbieter liefert keine Flugzeugliste"},
 {"Pull to refresh", "Zum Laden ziehen"},
 {"Queued", "Geplant"},
 {"Quote request failed", "Kursabfrage fehlgeschlagen"},
 {"Quote time unavailable", "Kurszeit nicht verfügbar"},
 {"Quote: ", "Kurs: "},
 {"Rain", "Regen"},
 {"Re-save symbols for selected provider", "Symbole für diesen Anbieter neu speichern"},
 {"Refresh", "Neu laden"},
 {"Refresh queued", "Vorgemerkt"},
 {"Refreshing...", "Aktualisierung läuft ..."},
 {"Region", "Region"},
 {"Registration", "Kennzeichen"},
 {"Release to refresh", "Zum Aktualisieren loslassen"},
 {"Remove", "Entfernen"},
 {"Remove favourite?", "Favorit entfernen?"},
 {"Reorder lines to reorder your watchlist", "Zeilen zum Umsortieren verschieben"},
 {"Response too large", "Antwort zu groß"},
 {"Result queue unavailable", "Ergebniswarteschlange nicht verfügbar"},
 {"Retry scheduled - please wait", "Neuer Versuch geplant – bitte warten"},
 {"Rise %s\nSet  %s", "Auf %s\nUnter %s"},
 {"Rise %s\nSet %s", "Auf %s\nUnter %s"},
 {"Rise --:--\nSet  --:--", "Auf --:--\nUnter --:--"},
 {"Rise --:--\nSet --:--", "Auf --:--\nUnter --:--"},
 {"Roll again", "Erneut würfeln"},
 {"Roll dice", "Würfeln"},
 {"Rolling...", "Würfelt ..."},
 {"Route unavailable", "Route nicht verfügbar"},
 {"Sat", "Sa"},
 {"Saturday", "Samstag"},
 {"Save", "Speichern"},
 {"Save & Back", "Speichern & zurück"},
 {"Save a stop to see departures", "Haltestelle für Abfahrten speichern"},
 {"Saved data - retrying", "Gespeicherte Daten – neuer Versuch"},
 {"Saved data - update failed", "Gespeicherte Daten – Update fehlgeschlagen"},
 {"Saved locations (tap to select)", "Gespeicherte Orte (antippen)"},
 {"Scan networks", "Netzwerke suchen"},
 {"Scan or enter an SSID manually", "Netzwerk suchen oder SSID eingeben"},
 {"Scheduled", "Fahrplan"},
 {"Score", "Punkte"},
 {"Screen Rotation", "Bildschirmdrehung"},
 {"Search", "Suchen"},
 {"Search uses Open-Meteo geocoding", "Ortssuche mit Open-Meteo"},
 {"Searching for Wi-Fi networks...", "WLAN-Netzwerke werden gesucht ..."},
 {"Searching...", "Suche läuft ..."},
 {"Selection cancelled\nRelease to continue", "Auswahl abgebrochen\nZum Fortfahren loslassen"},
 {"Set your location", "Ort festlegen"},
 {"Settings", "Einstellungen"},
 {"Settings > Planes", "Einstellungen > Flugzeuge"},
 {"Show FPS monitor", "FPS-Anzeige"},
 {"Showers", "Schauer"},
 {"Sixes", "Sechser"},
 {"Snow", "Schnee"},
 {"Software Update", "Software-Update"},
 {"Speed", "Tempo"},
 {"Stable updates are recommended. Prereleases may contain unfinished features.", "Stabile Versionen werden empfohlen. Vorabversionen können unfertige Funktionen enthalten."},
 {"Station, city or stop name", "Bahnhof, Ort oder Haltestelle"},
 {"Stocks", "Aktien"},
 {"Stop or trip no longer available", "Haltestelle oder Fahrt nicht mehr verfügbar"},
 {"Stops", "Haltestellen"},
 {"Storm", "Gewitter"},
 {"Straight", "Straße"},
 {"Sun", "Sonne"},
 {"Sun & Moon", "Sonne & Mond"},
 {"Sunday", "Sonntag"},
 {"Symbol not found", "Symbol nicht gefunden"},
 {"Symbol unavailable at Yahoo", "Symbol bei Yahoo nicht verfügbar"},
 {"System", "System"},
 {"Tap Search to look up stops", "Mit Suchen Haltestellen finden"},
 {"Tap a network to select it", "Netzwerk zum Auswählen antippen"},
 {"Tap a result to save it", "Ergebnis zum Speichern antippen"},
 {"This aircraft is no longer in the nearby results.", "Dieses Flugzeug ist nicht mehr in der Nähe."},
 {"Threes", "Dreier"},
 {"Thu", "Do"},
 {"Thunderstorm", "Gewitter"},
 {"Thursday", "Donnerstag"},
 {"Time", "Uhrzeit"},
 {"Times: device timezone", "Zeit: Gerätezeitzone"},
 {"Timezone", "Zeitzone"},
 {"Transit", "ÖPNV"},
 {"Transitous / MOTIS\n\nData and attribution:\nhttps://transitous.org/sources/\nOpenStreetMap contributors\n\nCoverage and live predictions vary by operator. All clock times use your device timezone.\n\nRefreshes every 2 minutes while open. Cached data is marked.\n\nPublic Transitous service: non-commercial use only. See transitous.org/api/", "Transitous / MOTIS\n\nDaten und Quellen:\nhttps://transitous.org/sources/\nOpenStreetMap-Mitwirkende\n\nAbdeckung und Echtzeitdaten hängen vom Betreiber ab. Alle Uhrzeiten gelten in der Gerätezeitzone.\n\nAktualisierung alle 2 Minuten bei geöffneter App. Gespeicherte Daten sind markiert.\n\nÖffentlicher Transitous-Dienst: nur nichtkommerzielle Nutzung. Siehe transitous.org/api/"},
 {"Transitous / Sources", "Transitous / Quellen"},
 {"Transitous access denied", "Transitous verweigert Zugriff"},
 {"Transitous rate limit", "Transitous-Anfragelimit erreicht"},
 {"Transitous unavailable - retry later", "Transitous nicht verfügbar – später erneut versuchen"},
 {"Trip details unavailable", "Fahrtdetails nicht verfügbar"},
 {"Try a larger radius", "Größeren Umkreis wählen"},
 {"Tue", "Di"},
 {"Tuesday", "Dienstag"},
 {"Twos", "Zweier"},
 {"Unavailable", "Nicht verfügbar"},
 {"Unknown", "Unbekannt"},
 {"Unknown type", "Unbekannter Typ"},
 {"Unnamed", "Ohne Namen"},
 {"Unsorted chart", "Unsortierter Kursverlauf"},
 {"Up to date (30s cooldown)", "Aktuell (30 s Wartezeit)"},
 {"Upcoming hours (local time)", "Nächste Stunden (Ortszeit)"},
 {"Update cancelled", "Update abgebrochen"},
 {"Update checks are available on the device build", "Update-Suche nur auf dem Gerät verfügbar"},
 {"Update does not support this device", "Update unterstützt dieses Gerät nicht"},
 {"Update failed - retry", "Update fehlgeschlagen"},
 {"Update failed: %s", "Update fehlgeschlagen: %s"},
 {"Update in progress\nDownloading and verifying firmware...", "Update läuft\nFirmware wird geladen und geprüft ..."},
 {"Update installed", "Update installiert"},
 {"Updated ", "Aktualisiert vor "},
 {"Updated %lus ago", "Vor %lu s aktualisiert"},
 {"Updating...", "Aktualisierung läuft ..."},
 {"Uptime", "Laufzeit"},
 {"Use stock symbols, e.g. AAPL or NESN.SW", "Börsensymbole verwenden, z. B. AAPL"},
 {"Used to compute OpenSky bounding box.", "Legt den Bereich der Flugzeugsuche fest."},
 {"Verified. Restarting...", "Geprüft. Neustart ..."},
 {"Version %s is available. Return to the app to install it.", "Version %s ist verfügbar. Zur Installation zur App zurückkehren."},
 {"Visibility Range (km)", "Umkreis (km)"},
 {"Waiting for Wi-Fi / clock", "Warte auf WLAN / Uhrzeit"},
 {"Waiting for aircraft", "Warte auf Flugzeuge"},
 {"Waiting for data", "Warte auf Daten"},
 {"Waiting for departures", "Warte auf Abfahrten"},
 {"Waiting for location time", "Warte auf Ortszeit"},
 {"Waiting for quote", "Warte auf Kurs"},
 {"Waiting for quote / Wi-Fi", "Warte auf Kurs / WLAN"},
 {"Waiting for time", "Warte auf Uhrzeit"},
 {"Waning crescent", "Abnehmende Sichel"},
 {"Waning gibbous", "Abnehmender Mond"},
 {"Watchlist", "Merkliste"},
 {"Waxing crescent", "Zunehmende Sichel"},
 {"Waxing gibbous", "Zunehmender Mond"},
 {"We have a new layout for you.\n\nPrefer the old one? Change it in Settings > Weather", "Es gibt eine neue Ansicht.\n\nDie bisherige Ansicht ist unter Einstellungen > Wetter verfügbar."},
 {"Weather", "Wetter"},
 {"Weather Icons", "Wettersymbole"},
 {"Weather layout", "Wetteransicht"},
 {"Wed", "Mi"},
 {"Wednesday", "Mittwoch"},
 {"WiFi", "WLAN"},
 {"Wind", "Wind"},
 {"Yahoo denied access", "Yahoo verweigert Zugriff"},
 {"Yahoo rate limit", "Yahoo-Anfragelimit erreicht"},
 {"You", "Du"},
 {"You previously ignored this version. You can install it now or keep ignoring it.", "Diese Version wurde ignoriert. Jetzt installieren oder weiterhin ignorieren."},
 {"Your next departure", "Deine nächste Abfahrt"},
 {"above sea level", "über Meereshöhe"},
 {"east", "Osten"},
 {"north", "Norden"},
 {"northeast", "Nordosten"},
 {"northwest", "Nordwesten"},
 {"s ago", " s"},
 {"south", "Süden"},
 {"southeast", "Südosten"},
 {"southwest", "Südwesten"},
 {"unknown location", "Unbekannter Ort"},
 {"west", "Westen"},
 {"  System", "  System"},
 {"  Software Update", "  Software-Update"},
 {"  Scan networks", "  Netzwerke suchen"},
 {" Refresh", " Neu laden"},
 {"  Display", "  Anzeige"},
 {" Add stop", " Haltestelle hinzufügen"},
 {"  Weather", "  Wetter"},
 {"  Time", "  Uhrzeit"},
 {"  Planes", "  Flugzeuge"},
 {"  WiFi", "  WLAN"},
};
